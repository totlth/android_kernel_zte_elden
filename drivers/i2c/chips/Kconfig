## drivers/i2c/chips/Kconfig
```kconfig
#
# Miscellaneous I2C chip drivers configuration
#
# *** DEPRECATED! Do not add new entries! See Makefile ***
#

menu "Miscellaneous I2C Chip support"

config SENSORS_TSL2550
	tristate "Taos TSL2550 ambient light sensor"
	depends on EXPERIMENTAL
	help
	  If you say yes here you get support for the Taos TSL2550
	  ambient light sensor.

	  This driver can also be built as a module.  If so, the module
	  will be called tsl2550.

config SENSORS_TSL2771
	tristate "Taos TSL2771 ambient light and prox sensor"
	depends on I2C
	default n
	help
	  If you say yes here you get support for the Taos TSL2771
	  ambient light and prox sensor.
	  
config SENSORS_BH1721
	tristate "BH1721 ambient light sensor"
	depends on I2C
	default n
	help
	  If you say yes here you get support for the BH1721
	  ambient light sensor.	   

#source "drivers/i2c/chips/mpu3050/Kconfig"

endmenu
```

## drivers/staging/zte_ftm/Kconfig
```kconfig
#
# Created by ZTE_BOOT_JIA_20120803 jia.jia
#

menu "ZTE FTM"

config ZTE_FTM
	bool "ZTE FTM Driver"
        default y
	---help---
	  Enable support for FTM driver needed on the ZTE platform

endmenu
```

## drivers/video/mhl/Kconfig
```kconfig
#
# HDMI to MHL  device configuration
#

menu "MHL sii8334 support"


config MHL_Sii8334
	tristate "MHL_Sii8334"
	default n
	help
	  If you say yes here you get support for the MHL_Sii8334 transimitter.

	  This driver can also be built as a module.  If so, the module
	  will be called MHL_Sii8334.

endmenu
```
